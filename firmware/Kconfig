## firmware/Kconfig
```kconfig
config DECK8_LED_STRIP_CHAIN
    bool "Drive several LED strips as one"
    default y
    depends on DT_HAS_DECK8_LED_STRIP_CHAIN_ENABLED
    depends on LED_STRIP

config DECK8_RGB_BATTERY_GUARD
    bool "Turn the RGB off when the battery is too low for the LEDs"
    default y
    depends on ZMK_RGB_UNDERGLOW && ZMK_BATTERY_REPORTING
    help
      SK6812 LEDs need about 3.7 V. Off USB, VLED is the battery voltage, so below the threshold the
      colours go wrong before the cell is empty. The guard switches the RGB off then; turn it back on by hand.

config DECK8_RGB_BATTERY_GUARD_MV
    int "Battery voltage below which the RGB is switched off (mV)"
    default 3700
    depends on DECK8_RGB_BATTERY_GUARD
```

## firmware/boards/deck8/Kconfig.defconfig
```kconfig
if BOARD_DECK8

config ZMK_KEYBOARD_NAME
    default "Deck-8"

if USB_DEVICE_STACK

config USB_NRFX
    default y

endif # USB_DEVICE_STACK

endif # BOARD_DECK8
```

## firmware/boards/deck8/board.yml
```yaml
board:
  name: deck8
  socs:
    - name: nrf52840
      variants:
        - name: zmk
```

## firmware/dts/bindings/led_strip/deck8,led-strip-chain.yaml
```yaml
description: |
  Several LED strips shown as one strip, in the order listed. Pixel 0 of the chain is pixel 0 of the
  first strip; the next strip starts where the previous one ends. Lets ZMK's underglow, which drives a
  single strip, run its effects across LEDs on separate data pins.

compatible: "deck8,led-strip-chain"

properties:
  strips:
    type: phandles
    required: true
    description: The strips, in pixel order.
  chain-length:
    type: int
    required: true
    description: Total number of pixels; must equal the sum of the strips' chain-length.
```
